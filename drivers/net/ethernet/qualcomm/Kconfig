## drivers/net/ethernet/qualcomm/Kconfig
```kconfig
# SPDX-License-Identifier: GPL-2.0-only
#
# Qualcomm network device configuration
#

config NET_VENDOR_QUALCOMM
	bool "Qualcomm devices"
	default y
	help
	  If you have a network (Ethernet) card belonging to this class, say Y.

	  Note that the answer to this question doesn't directly affect the
	  kernel: saying N will just cause the configurator to skip all
	  the questions about Qualcomm cards. If you say Y, you will be asked
	  for your specific card in the following questions.

if NET_VENDOR_QUALCOMM

config QCA7000
	tristate
	help
	  This enables support for the Qualcomm Atheros QCA7000.

config QCA7000_SPI
	tristate "Qualcomm Atheros QCA7000 SPI support"
	select QCA7000
	depends on SPI_MASTER && OF
	help
	  This SPI protocol driver supports the Qualcomm Atheros QCA7000.

	  To compile this driver as a module, choose M here. The module
	  will be called qcaspi.

config QCA7000_UART
	tristate "Qualcomm Atheros QCA7000 UART support"
	select QCA7000
	depends on SERIAL_DEV_BUS && OF
	help
	  This UART protocol driver supports the Qualcomm Atheros QCA7000.

	  Currently the driver assumes these device UART settings:
	    Data bits: 8
	    Parity: None
	    Stop bits: 1
	    Flow control: None

	  To compile this driver as a module, choose M here. The module
	  will be called qcauart.

config QCOM_EMAC
	tristate "Qualcomm EMAC Gigabit Ethernet support"
	depends on HAS_DMA && HAS_IOMEM
	select CRC32
	select PHYLIB
	help
	  This driver supports the Qualcomm Technologies, Inc. Gigabit
	  Ethernet Media Access Controller (EMAC). The controller
	  supports IEEE 802.3-2002, half-duplex mode at 10/100 Mb/s,
	  full-duplex mode at 10/100/1000Mb/s, Wake On LAN (WOL) for
	  low power, Receive-Side Scaling (RSS), and IEEE 1588-2008
	  Precision Clock Synchronization Protocol.

config QCOM_PPE
	tristate "Qualcomm PPE Ethernet support"
	depends on COMMON_CLK && HAS_IOMEM && OF
	depends on ARCH_QCOM || COMPILE_TEST
	select REGMAP_MMIO
	help
	  This driver supports the Qualcomm Technologies, Inc. packet
	  process engine (PPE) available with IPQ SoC. The PPE includes
	  the Ethernet MACs, Ethernet DMA (EDMA) and switch core that
	  supports L3 flow offload, L2 switch function, RSS and tunnel
	  offload.

	  To compile this driver as a module, choose M here. The module
	  will be called qcom-ppe.

config QCOM_PPE_DSA
	bool "Qualcomm PPE DSA switch support"
	depends on QCOM_PPE
	depends on NET_DSA
	depends on NET_DSA=y || QCOM_PPE=m
	depends on PCS_QCA_UNIPHY
	help
	  This option lets the Qualcomm PPE register its ports as a DSA
	  switch, with the CPU port connected to the Ethernet DMA. It is
	  used on SoCs with a switch behind a single conduit, such as the
	  IPQ6018.

config QCOM_PPE_DIRECT
	bool "Qualcomm PPE direct port support"
	depends on QCOM_PPE
	depends on PCS_QCA_UNIPHY
	help
	  This option gives each port of the Qualcomm PPE a network device
	  of its own, which sends and receives frames through the Ethernet
	  DMA. The ports are described by the port nodes of the PPE that
	  have no "ethernet" property, and each has a PHY and a PCS of the
	  UNIPHY.

source "drivers/net/ethernet/qualcomm/rmnet/Kconfig"

endif # NET_VENDOR_QUALCOMM
```
